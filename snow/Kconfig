## snow/holder/Kconfig
```kconfig
#
# For a description of the syntax of this configuration file,
# see the file kconfig-language.txt in the NuttX tools repository.
#

config CONFIG_HOLDER_APP_HOLDER
	tristate "Snowblower holder application"
	default n
	depends on HAVE_CXX
	---help---
		Enable the holder application
```

## snow/rotor/Kconfig
```kconfig
#
# For a description of the syntax of this file, see the Kconfig scripting
# language manual at http://www.kernel.org/doc/Documentation/kbuild/kconfig-language.txt
#

config SNOW_ROTOR
	tristate "Rotor control daemon"
	default n
	---help---
		Enable the rotor control daemon.

if SNOW_ROTOR

config SNOW_ROTOR_PROGNAME
	string "Program name"
	default "rotor"

config SNOW_ROTOR_PRIORITY
	int "Rotor daemon priority"
	default 100

config SNOW_ROTOR_STACKSIZE
	int "Rotor daemon stack size"
	default 2048

endif
```

## snow/snowblower/Kconfig
```kconfig
#
# For a description of the syntax of this configuration file,
# see the file kconfig-language.txt in the NuttX tools repository.
#

config CONFIG_SNOW_APP_SNOWBLOWER
	tristate "Snowblower application"
	default n
	depends on HAVE_CXX
	---help---
		Enable the snowblower application
```
